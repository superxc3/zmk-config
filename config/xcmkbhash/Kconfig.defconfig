## config/xcmkbhash/Kconfig.defconfig
```kconfig
# Copyright (c) 2020 The ZMK Contributors
# SPDX-License-Identifier: MIT

if SHIELD_XCMKBHASH

config ZMK_KEYBOARD_NAME
    default "XCMKB_HASH"

endif
```

## config/xcmkbhash/Kconfig.shield
```kconfig
# Copyright (c) 2020 The ZMK Contributors
# SPDX-License-Identifier: MIT

config SHIELD_XCMKBHASH
    def_bool $(shields_list_contains,xcmkbhash)
```
